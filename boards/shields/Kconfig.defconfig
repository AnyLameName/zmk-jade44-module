## boards/shields/Kconfig.defconfig
```kconfig
if SHIELD_JADE44_LEFT
  config ZMK_KEYBOARD_NAME
    default "Jade 44"

  config ZMK_SPLIT_ROLE_CENTRAL
    default y
endif

if SHIELD_JADE44_LEFT || SHIELD_JADE44_RIGHT
  config ZMK_SPLIT
    default y
endif
```

## boards/shields/jade44/Kconfig.shield
```kconfig
# Copyright (c) 2025 Jay Gagnon
# SPDX-License-Identifier: MIT

config SHIELD_JADE44_LEFT
    def_bool $(shields_list_contains,jade44_left)

config SHIELD_JADE44_RIGHT
    def_bool $(shields_list_contains,jade44_right)
```
