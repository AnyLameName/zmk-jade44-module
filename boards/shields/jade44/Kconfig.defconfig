## boards/shields/jade44/Kconfig.defconfig
```kconfig
if SHIELD_JADE44_LEFT
  config ZMK_KEYBOARD_NAME
    default "Jade44 v2"

  config ZMK_SPLIT_ROLE_CENTRAL
    default y
endif

if SHIELD_JADE44_LEFT || SHIELD_JADE44_RIGHT
  config ZMK_SPLIT
    default y
endif
```
