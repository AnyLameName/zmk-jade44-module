## config/west.yml
```yaml
manifest:
  remotes:
    - name: zmkfirmware
      url-base: https://github.com/zmkfirmware
    - name: AnyLameName
      url-base: https://github.com/AnyLameName
  projects:
    - name: zmk
      remote: zmkfirmware
      revision: main
      import: app/west.yml
    - name: nice-view-jade44
      remote: AnyLameName
      revision: main
    - name: zmk-jade44-module
      remote: AnyLameName
      revision: main
  self:
    path: config
```
